## build/Kconfig/Kconfig.shield
```kconfig
osource "/Users/imisslinux/Documents/NTNU/ElsysProsjekt/nrf9160_testspace/elsys_prosjekt/boards/shields/*/Kconfig.shield"
osource "/opt/nordic/ncs/v1.9.0/nrf/boards/shields/*/Kconfig.shield"
```
